#include <input/processors.dtsi>

&spi0 {
    status = "okay";
    trackball_central: trackball@0 {
        status = "okay";
        compatible = "pixart,paw3222";
        reg = <0>;
        spi-max-frequency = <2000000>;
        irq-gpios = <&xiao_d 6 (GPIO_ACTIVE_LOW | GPIO_PULL_UP)>;
    };
};

&peripheral_listener {
    status = "okay";
};

&central_listener {
    status = "okay";
    device = <&trackball_central>;
    input-processors = <&zip_temp_layer 4 10000>;
};
